## drivers/net/wireless/mediatek/mt7601u/Kconfig
```kconfig
# SPDX-License-Identifier: GPL-2.0-only
config MT7601U
	tristate "MediaTek MT7601U (USB) support"
	depends on MAC80211
	depends on USB
	help
	  This adds support for MT7601U-based USB wireless dongles.

config MT7601U_RESEARCH
	bool "MT7601U research / experimental features (raw TX, RF test, MAC-rand, CSI probe)"
	depends on MT7601U
	default n
	help
	  Compile the surface-A research feature set into the mt7601u driver:
	  raw packet injection from a monitor vif, RF/baseband test modes
	  (continuous-TX / single-tone -- these EMIT a carrier on 2.4 GHz and are
	  LAB / SHIELDED-CHAMBER ONLY, subject to RF regulation), silent-capture
	  (auto-ACK disable), fast MAC randomization, and the CSI-feasibility
	  BBP-block-dump probe. All are exposed via debugfs / module params and
	  are for RF bring-up and security research, NOT normal operation.

	  If unsure, say N. The fleet production kernel MUST keep this N so the
	  emitting / spoofing / raw-TX surface is not compiled into shipped images.
```

## drivers/soc/amlogic/Kconfig
```kconfig
# SPDX-License-Identifier: GPL-2.0-only
menu "Amlogic SoC drivers"

config MESON_CANVAS
	tristate "Amlogic Meson Canvas driver"
	depends on ARCH_MESON || COMPILE_TEST
	default n
	help
	  Say yes to support the canvas IP for Amlogic SoCs.

config MESON_CLK_MEASURE
	tristate "Amlogic Meson SoC Clock Measure driver"
	depends on ARCH_MESON || COMPILE_TEST
	default ARCH_MESON
	select REGMAP_MMIO
	help
	  Say yes to support of Measuring a set of internal SoC clocks
	  from the debugfs interface.

config MESON_GX_SOCINFO
	bool "Amlogic Meson GX SoC Information driver"
	depends on (ARM64 && ARCH_MESON) || COMPILE_TEST
	default ARCH_MESON
	select SOC_BUS
	help
	  Say yes to support decoding of Amlogic Meson GX SoC family
	  information about the type, package and version.

config MESON_MX_SOCINFO
	bool "Amlogic Meson MX SoC Information driver"
	depends on (ARM && ARCH_MESON) || COMPILE_TEST
	default ARCH_MESON
	select SOC_BUS
	help
	  Say yes to support decoding of Amlogic Meson6, Meson8,
	  Meson8b and Meson8m2 SoC family information about the type
	  and version.

config MESON_DMC_PORT_PRIORITY
	bool "Amlogic Meson G12B DMC port priority"
	depends on ARCH_MESON || COMPILE_TEST
	default ARCH_MESON
	help
	  Apply the per-port DDR arbitration priorities a board's device tree
	  lists (amlogic,port-priority) to the G12B memory controller at boot.
	  Built-in so the priorities are live before any requester driver
	  submits work; a board whose device tree lists no port is untouched.

config MESON_SC_HEARTBEAT
	bool "Amlogic SM1 kernel heartbeat for the open System Controller"
	depends on ARCH_MESON || COMPILE_TEST
	default n
	help
	  Advances a heartbeat word in SRAM that the open System Controller
	  (scp-firmware SCP_G12A_AP_HEARTBEAT) watches: once it has seen the
	  word change, a kernel that stops advancing it for the SC's grace
	  period is reset through the AO watchdog, even when no EE watchdog
	  runs.  Pauses across system sleep and releases the SC on halt,
	  power-off and kexec.  Built in only (the kexec test reads
	  kexec_in_progress).  A board opts in through its device tree node.

config MESON_GXL_DDR_PUB_MON
	tristate "Amlogic GXL DDR PHY (PUB) VT telemetry monitor"
	depends on ARCH_MESON || COMPILE_TEST
	default ARCH_MESON
	help
	  Read-only sampler for the GXL DDR PHY voltage/temperature drift
	  tracking state: per-delay-line-field statistics in debugfs and a
	  tracepoint on every field change, so a memory fault can be read
	  against what the PHY was doing.

config MESON_GXL_DDR_PUB_MON_KUNIT_TEST
	bool "KUnit tests for the GXL DDR PHY (PUB) VT telemetry monitor" if !KUNIT_ALL_TESTS
	depends on MESON_GXL_DDR_PUB_MON && KUNIT
	default KUNIT_ALL_TESTS
	help
	  KUnit tests of the SC-mode reader: the seqcount copy of the block
	  the AO Cortex-M3 publishes (torn/odd/zero seq, lost magic, field
	  and change-ring unpacking), the rate clamp, block validation, the
	  reset-ack wait and the read-path liveness gate, against a block in
	  kernel memory. Run with
	  tools/testing/kunit/kunit.py run --kunitconfig=drivers/soc/amlogic --arch=x86_64

config MESON_GE2D_API
	bool "Amlogic GE2D kernel API"
	depends on ARCH_MESON || COMPILE_TEST
	help
	  Built-in API shim for the GE2D 2D engine, allowing built-in
	  drivers (e.g. DRM writeback) to use GE2D when the V4L2 GE2D
	  driver is loaded as a module.

endmenu
```

## drivers/soc/mediatek/Kconfig
```kconfig
# SPDX-License-Identifier: GPL-2.0-only
#
# MediaTek SoC drivers
#
menu "MediaTek SoC drivers"
	depends on ARCH_MEDIATEK || COMPILE_TEST

config MTK_CMDQ
	tristate "MediaTek CMDQ Support"
	depends on ARCH_MEDIATEK || COMPILE_TEST
	select MAILBOX
	select MTK_CMDQ_MBOX
	select MTK_INFRACFG
	help
	  Say yes here to add support for the MediaTek Command Queue (CMDQ)
	  driver. The CMDQ is used to help read/write registers with critical
	  time limitation, such as updating display configuration during the
	  vblank.

config MTK_DEVAPC
	tristate "Mediatek Device APC Support"
	help
	  Say yes here to enable support for Mediatek Device APC driver.
	  This driver is mainly used to handle the violation which catches
	  unexpected transaction.
	  The violation information is logged for further analysis or
	  countermeasures.

config MTK_DVFSRC
	tristate "MediaTek DVFSRC Support"
	depends on ARCH_MEDIATEK
	help
	  Say yes here to add support for the MediaTek Dynamic Voltage
	  and Frequency Scaling Resource Collector (DVFSRC): a HW
	  IP found on many MediaTek SoCs, which is responsible for
	  collecting DVFS requests from various SoC IPs, other than
	  software, and performing bandwidth scaling to provide the
	  best achievable performance-per-watt.

config MTK_INFRACFG
	bool "MediaTek INFRACFG Support"
	select REGMAP
	help
	  Say yes here to add support for the MediaTek INFRACFG controller. The
	  INFRACFG controller contains various infrastructure registers not
	  directly associated to any device.

config MTK_PMIC_WRAP
	tristate "MediaTek PMIC Wrapper Support"
	depends on RESET_CONTROLLER
	depends on OF
	select REGMAP
	help
	  Say yes here to add support for MediaTek PMIC Wrapper found
	  on different MediaTek SoCs. The PMIC wrapper is a proprietary
	  hardware to connect the PMIC.

config MTK_REGULATOR_COUPLER
	bool "MediaTek SoC Regulator Coupler" if COMPILE_TEST
	default ARCH_MEDIATEK
	depends on REGULATOR

config MTK_MMSYS
	tristate "MediaTek MMSYS Support"
	default ARCH_MEDIATEK
	depends on HAS_IOMEM
	depends on MTK_CMDQ || MTK_CMDQ=n
	help
	  Say yes here to add support for the MediaTek Multimedia
	  Subsystem (MMSYS).

config MTK_SVS
	tristate "MediaTek Smart Voltage Scaling(SVS)"
	depends on NVMEM_MTK_EFUSE && NVMEM
	help
	  The Smart Voltage Scaling(SVS) engine is a piece of hardware
	  which has several controllers(banks) for calculating suitable
	  voltage to different power domains(CPU/GPU/CCI) according to
	  chip process corner, temperatures and other factors. Then DVFS
	  driver could apply SVS bank voltage to PMIC/Buck.

config MTK_SOCINFO
	tristate "MediaTek SoC Information"
	default y
	depends on NVMEM_MTK_EFUSE
	select SOC_BUS
	help
	  The MediaTek SoC Information (mtk-socinfo) driver provides
	  information about the SoC to the userspace including the
	  manufacturer name, marketing name and soc name.

config MTK_MT8183_IPU_PROBE
	tristate "MediaTek MT8183 IPU/VP6 reachability probe"
	depends on ARCH_MEDIATEK || COMPILE_TEST
	depends on MFD_SYSCON && PM_GENERIC_DOMAINS
	help
	  Minimal experimental probe for the MT8183 (Helio P60) IPU / VP6
	  DSP block. Powers on the VPU_TOP/CORE0 power domains and reads a
	  few ipu_conn / ipu_core0 syscon registers to prove the VP6 block
	  is reachable from mainline Linux. It is NOT a functional VPU
	  driver -- there is no MT8183 VP6 firmware and no open toolchain.
	  Say M here only for hardware bring-up investigation.

config MTK_MT8183_VP6
	tristate "MediaTek MT8183/MT8365 VP6 (IPU/APU / Cadence Vision-P6) driver"
	depends on ARCH_MEDIATEK || COMPILE_TEST
	depends on MFD_SYSCON && PM_GENERIC_DOMAINS
	depends on HAS_DMA
	help
	  Driver for the MediaTek Cadence Vision-P6 (VP6) DSP: the MT8183 (Helio
	  P60 / Genio 500) dual cores (ipu_core0/ipu_core1) and the MT8365 (Genio
	  350) single core (apu_core, no ipu_conn fabric). Selected per-SoC via
	  of_match match data. Powers each core, stages a VP6 firmware image into
	  DDR, releases it from reset, and exposes a per-core /dev/vp6-N character
	  device with firmware-load, reset/halt, host<->core mailbox, and
	  shared-buffer (mmap) ioctls (uapi <linux/mtk-vp6.h>).

	  On mt8183 execution is firmware-gated (no image exists). The mt8365 VP6
	  has a vendor OpenAMP/remoteproc prebuilt (rproc-vp6-fw / xann_0, Cadence
	  config MVPU6_0226) consumable via the rproc load path. The
	  power/clock/register/reset/mailbox-doorbell/buffer paths are usable for
	  bring-up without firmware. Say M for VP6 bring-up.

endmenu
```

## drivers/soc/rockchip/Kconfig
```kconfig
# SPDX-License-Identifier: GPL-2.0-only
if ARCH_ROCKCHIP || COMPILE_TEST

#
# Rockchip Soc drivers
#

config ROCKCHIP_GRF
	bool "Rockchip General Register Files support" if COMPILE_TEST
	default y if ARCH_ROCKCHIP
	help
	  The General Register Files are a central component providing
	  special additional settings registers for a lot of soc-components.
	  In a lot of cases there also need to be default settings initialized
	  to make some of them conform to expectations of the kernel.

config ROCKCHIP_IODOMAIN
	tristate "Rockchip IO domain support"
	depends on OF
	help
	  Say y here to enable support io domains on Rockchip SoCs. It is
	  necessary for the io domain setting of the SoC to match the
	  voltage supplied by the regulators.

config ROCKCHIP_DTPM
	tristate "Rockchip DTPM hierarchy"
	depends on DTPM && m
	help
	  Describe the hierarchy for the Dynamic Thermal Power Management tree
	  on this platform. That will create all the power capping capable
	  devices.

config ROCKCHIP_M0_I2C_OFFLOAD
	tristate "Rockchip RK3399 M0 I2C offload service"
	depends on OF && MAILBOX && I2C
	help
	  Say M here to let the kernel serve I2C transfers that the BL31
	  Cortex-M0 SCMI server offloads to it over mailbox1, instead of
	  the firmware owning a PMIC I2C bus itself. The M0 needs a few
	  PMIC register accesses to answer CPU OPP voltage requests and
	  posts them one at a time to a shared page; this driver runs the
	  transfer on the bus that Linux owns and answers back. It is
	  inert on boards whose firmware does not host such a server.

endif
```
