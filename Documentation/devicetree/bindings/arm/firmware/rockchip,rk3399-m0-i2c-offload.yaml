## Documentation/devicetree/bindings/arm/firmware/rockchip,rk3399-m0-i2c-offload.yaml
```yaml
# SPDX-License-Identifier: (GPL-2.0-only OR BSD-2-Clause)
%YAML 1.2
---
$id: http://devicetree.org/schemas/arm/firmware/rockchip,rk3399-m0-i2c-offload.yaml#
$schema: http://devicetree.org/meta-schemas/core.yaml#

title: Rockchip RK3399 M0 I2C offload service

description: |
  The Cortex-M0 SCMI server hosted by the board's BL31 firmware can
  offload single PMIC register accesses to Linux instead of owning a PMIC
  I2C bus itself. One request at a time is posted to the shared page
  mapped by this node and delivered by the referenced mailbox channel;
  the service driver answers in the same page and rings the channel
  back. Page layout is documented in
  drivers/soc/rockchip/rockchip-m0-i2c-offload.c.

properties:
  compatible:
    const: rockchip,rk3399-m0-i2c-offload

  reg:
    maxItems: 1
    description:
      Shared request/response page, 64 bytes, in the firmware-reserved
      region below the kernel's first memory bank.

  mboxes:
    maxItems: 1
    description:
      Doorbell channel used for both the request ring (firmware to
      kernel) and the completion ring (kernel to firmware).

  rockchip,pwrctrl:
    $ref: /schemas/types.yaml#/definitions/phandle
    description:
      I2C PMIC node the firmware is allowed to touch through this
      service. Requests for any other device address are rejected.

required:
  - compatible
  - reg
  - mboxes
  - rockchip,pwrctrl

additionalProperties: false

examples:
  - |
    m0-i2c-offload@101000 {
        compatible = "rockchip,rk3399-m0-i2c-offload";
        reg = <0x0 0x00101000 0x0 0x40>;
        mboxes = <&mbox1 1>;
        rockchip,pwrctrl = <&rk808>;
    };
```

## Documentation/devicetree/bindings/media/cec/mediatek,mt8188-cec.yaml
```yaml
# SPDX-License-Identifier: GPL-2.0-only OR BSD-2-Clause
%YAML 1.2
---
$id: http://devicetree.org/schemas/media/cec/mediatek,mt8188-cec.yaml#
$schema: http://devicetree.org/meta-schemas/core.yaml#

title: MediaTek MT8188 HDMI CEC

maintainers:
  - Yansheng Xue <xia@lessconfused.com>

description:
  The HDMI CEC controller of the MediaTek MT8188, a device of its own beside
  the HDMI transmitter. The transmitter reports the sink's physical address
  through the CEC notifier, found with hdmi-phandle.

allOf:
  - $ref: cec-common.yaml#

properties:
  compatible:
    const: mediatek,mt8188-cec

  reg:
    maxItems: 1

  interrupts:
    maxItems: 1

  clocks:
    items:
      - description: CEC 66 MHz bus clock (HCLK)
      - description: CEC 66 MHz bus clock (BCLK)
      - description: HDMI 32 kHz clock
      - description: HDMI 26 MHz clock

  clock-names:
    items:
      - const: cec_66m_h
      - const: cec_66m_b
      - const: hdmi_32k
      - const: hdmi_26m

required:
  - compatible
  - reg
  - interrupts
  - clocks
  - clock-names
  - hdmi-phandle

unevaluatedProperties: false

examples:
  - |
    #include <dt-bindings/clock/mediatek,mt8188-clk.h>
    #include <dt-bindings/interrupt-controller/arm-gic.h>

    cec@10014000 {
        compatible = "mediatek,mt8188-cec";
        reg = <0x10014000 0x100>;
        interrupts = <GIC_SPI 680 IRQ_TYPE_LEVEL_HIGH 0>;
        clocks = <&infracfg_ao CLK_INFRA_AO_CEC_66M_HCLK>,
                 <&infracfg_ao CLK_INFRA_AO_CEC_66M_BCLK>,
                 <&infracfg_ao CLK_INFRA_AO_HDMI_32K>,
                 <&infracfg_ao CLK_INFRA_AO_HDMI_26M>;
        clock-names = "cec_66m_h", "cec_66m_b", "hdmi_32k", "hdmi_26m";
        hdmi-phandle = <&hdmi>;
    };
```

## Documentation/devicetree/bindings/media/mediatek,mt8188-aie.yaml
```yaml
# SPDX-License-Identifier: (GPL-2.0-only OR BSD-2-Clause)
%YAML 1.2
---
$id: http://devicetree.org/schemas/media/mediatek,mt8188-aie.yaml#
$schema: http://devicetree.org/meta-schemas/core.yaml#

title: MediaTek AI Engine (AIE) for Face Detection

maintainers:
  - Fish Wu <fish.wu@mediatek.com>
  - Bo Kong <bo.kong@mediatek.com>

description: |
  The MediaTek AI Engine (AIE) provides hardware-accelerated face detection,
  facial landmark detection, and face attribute analysis. It is found in the
  IPE (Image Processing Engine) subsystem of MediaTek SoCs.

properties:
  compatible:
    enum:
      - mediatek,mt8188-aie

  reg:
    maxItems: 1

  interrupts:
    maxItems: 1

  clocks:
    items:
      - description: clock for imgsys main ipe
      - description: clock for ipe fdvt
      - description: clock for ipe smi larb12
      - description: clock for ipe top

  clock-names:
    items:
      - const: img-ipe
      - const: ipe-fdvt
      - const: ipe-smi-larb12
      - const: ipe-top

  power-domains:
    maxItems: 1

  iommus:
    maxItems: 4
    description:
      The FDVT ports of larb 12 that bus-master for a job. RDA_0 and RDB_0 read
      the source luma and chroma, WRA_0 and WRB_0 write the detections and the
      attribute output; all four must be in the domain the job runs in, so a
      node that lists only RDA_0 leaves the other three unmapped.

  mediatek,larb:
    $ref: /schemas/types.yaml#/definitions/phandle
    description: phandle to the local arbiter (LARB) node

required:
  - compatible
  - reg
  - interrupts
  - clocks
  - clock-names
  - power-domains

additionalProperties: false

examples:
  - |
    #include <dt-bindings/interrupt-controller/arm-gic.h>
    #include <dt-bindings/clock/mediatek,mt8188-clk.h>
    #include <dt-bindings/memory/mediatek,mt8188-memory-port.h>
    #include <dt-bindings/power/mediatek,mt8188-power.h>

    soc {
        #address-cells = <2>;
        #size-cells = <2>;

        aie@15310000 {
            compatible = "mediatek,mt8188-aie";
            reg = <0 0x15310000 0 0x1000>;
            interrupts = <GIC_SPI 787 IRQ_TYPE_LEVEL_HIGH 0>;
            clocks = <&imgsys CLK_IMGSYS_MAIN_IPE>,
                     <&ipesys CLK_IPE_FDVT>,
                     <&ipesys CLK_IPE_SMI_LARB12>,
                     <&ipesys CLK_IPESYS_TOP>;
            clock-names = "img-ipe", "ipe-fdvt",
                          "ipe-smi-larb12", "ipe-top";
            power-domains = <&spm MT8188_POWER_DOMAIN_IPE>;
            iommus = <&vpp_iommu M4U_PORT_L12_FDVT_RDA_0>,
                     <&vpp_iommu M4U_PORT_L12_FDVT_RDB_0>,
                     <&vpp_iommu M4U_PORT_L12_FDVT_WRA_0>,
                     <&vpp_iommu M4U_PORT_L12_FDVT_WRB_0>;
            mediatek,larb = <&larb12>;
        };
    };
```

## Documentation/devicetree/bindings/media/mediatek,mt8188-dpe.yaml
```yaml
# SPDX-License-Identifier: (GPL-2.0-only OR BSD-2-Clause)
%YAML 1.2
---
$id: http://devicetree.org/schemas/media/mediatek,mt8188-dpe.yaml#
$schema: http://devicetree.org/meta-schemas/core.yaml#

title: MediaTek MT8188 Depth Engine (DPE)

maintainers:
  - Yansheng Xue <da@lessconfused.com>

description: |
  The depth engine in the IPE subsystem of MT8188. Its DVS block matches a
  rectified left/right image pair and writes a disparity map; its DVP block
  post-processes that map. DVS signals a finished job on a level interrupt.

properties:
  compatible:
    enum:
      - mediatek,mt8188-dpe

  reg:
    maxItems: 1

  interrupts:
    maxItems: 1

  clocks:
    items:
      - description: clock for imgsys main ipe
      - description: clock for ipe smi larb12
      - description: clock for ipe top
      - description: clock for ipe dpe

  clock-names:
    items:
      - const: img-ipe
      - const: ipe-smi-larb12
      - const: ipe-top
      - const: ipe-dpe

  power-domains:
    maxItems: 1

  iommus:
    maxItems: 4
    description:
      The DVS and DVP read and write ports of larb 12.

  mediatek,larb:
    $ref: /schemas/types.yaml#/definitions/phandle
    description: phandle to the local arbiter (LARB) node

required:
  - compatible
  - reg
  - interrupts
  - clocks
  - clock-names
  - power-domains
  - iommus

additionalProperties: false

examples:
  - |
    #include <dt-bindings/interrupt-controller/arm-gic.h>
    #include <dt-bindings/clock/mediatek,mt8188-clk.h>
    #include <dt-bindings/memory/mediatek,mt8188-memory-port.h>
    #include <dt-bindings/power/mediatek,mt8188-power.h>

    soc {
        #address-cells = <2>;
        #size-cells = <2>;

        dpe@15300000 {
            compatible = "mediatek,mt8188-dpe";
            reg = <0 0x15300000 0 0x1000>;
            interrupts = <GIC_SPI 789 IRQ_TYPE_LEVEL_HIGH 0>;
            clocks = <&imgsys CLK_IMGSYS_MAIN_IPE>,
                     <&ipesys CLK_IPE_SMI_LARB12>,
                     <&ipesys CLK_IPESYS_TOP>,
                     <&ipesys CLK_IPE_DPE>;
            clock-names = "img-ipe", "ipe-smi-larb12", "ipe-top", "ipe-dpe";
            power-domains = <&spm MT8188_POWER_DOMAIN_IPE>;
            iommus = <&vpp_iommu M4U_PORT_L12_DVS_RDMA>,
                     <&vpp_iommu M4U_PORT_L12_DVS_WDMA>,
                     <&vpp_iommu M4U_PORT_L12_DVP_RDMA>,
                     <&vpp_iommu M4U_PORT_L12_DVP_WDMA>;
            mediatek,larb = <&larb12>;
        };
    };
```

## Documentation/devicetree/bindings/soc/amlogic/amlogic,g12b-dmc-port-priority.yaml
```yaml
# SPDX-License-Identifier: (GPL-2.0-only OR BSD-2-Clause)
%YAML 1.2
---
$id: http://devicetree.org/schemas/soc/amlogic/amlogic,g12b-dmc-port-priority.yaml#
$schema: http://devicetree.org/meta-schemas/core.yaml#

title: Amlogic G12B DMC per-port DDR arbitration priority

maintainers:
  - Libre Computer <hello@libre.computer>

description: |
  The G12B DDR memory controller (DMC) arbitrates its requester ports through
  one CHAN_CTRL register per port, whose bits [18:16] carry a 3-bit priority
  weight. Firmware leaves every port at 0. This node covers the channel-control
  register window (DMC_AM0_CHAN_CTRL through DMC_AXI11_HOLD_CTRL) and lists the
  ports a board raises at boot. Without amlogic,port-priority nothing is
  written.

  Port numbers follow the DMC's requester numbering, which is also the bit
  numbering of the amlogic,g12b-ddr-pmu config1 axi-line filter: 0 ARM,
  1 MALI, 3 HDCP, 4 HEVC front, 5 TEST, 6 USB3.0, 7 DEVICE, 8 HEVC back,
  9 H265ENC, 10 NNA, 11 GDC, 16/17/18 VPU0/1/2 read, 19/20 VPU0/1 write,
  21 VDEC, 22 HCODEC, 23 GE2D. Ports 2, 12 and 13 have no usable priority
  register and are refused.

properties:
  compatible:
    const: amlogic,g12b-dmc-port-priority

  reg:
    maxItems: 1
    description: DMC channel-control register window.

  amlogic,port-priority:
    $ref: /schemas/types.yaml#/definitions/uint32-matrix
    description: (port, priority) pairs applied at boot and on resume.
    items:
      items:
        - description: DMC requester port number
          minimum: 0
          maximum: 23
        - description: priority weight, 0 (lowest, the firmware default) to 7
          minimum: 0
          maximum: 7

required:
  - compatible
  - reg

additionalProperties: false

examples:
  - |
    bus {
        #address-cells = <2>;
        #size-cells = <2>;

        qos@180 {
            compatible = "amlogic,g12b-dmc-port-priority";
            reg = <0x0 0x180 0x0 0x140>;
            amlogic,port-priority = <10 4>;
        };
    };
```

## Documentation/devicetree/bindings/soc/amlogic/amlogic,gxl-ddr-pub-mon.yaml
```yaml
# SPDX-License-Identifier: (GPL-2.0-only OR BSD-2-Clause)
%YAML 1.2
---
$id: http://devicetree.org/schemas/soc/amlogic/amlogic,gxl-ddr-pub-mon.yaml#
$schema: http://devicetree.org/meta-schemas/core.yaml#

title: Amlogic GXL DDR PHY (PUB) VT telemetry monitor

maintainers:
  - Da Xue <da@libre.computer>

description: |
  Monitor registers of the Amlogic GXL DDR PHY ("PUB") VT tracking delay
  lines.

properties:
  compatible:
    const: amlogic,gxl-ddr-pub-mon

  reg:
    maxItems: 1

  amlogic,sc-shmem:
    $ref: /schemas/types.yaml#/definitions/phandle
    description:
      Phandle of the SC-published statistics block, a child of the SRAM
      controller described by
      Documentation/devicetree/bindings/soc/amlogic/amlogic,gxl-pubmon-sc-shmem.yaml.

required:
  - compatible
  - reg

additionalProperties: false

examples:
  - |
    sram@c8000000 {
        compatible = "mmio-sram";
        reg = <0xc8000000 0x14000>;
        #address-cells = <1>;
        #size-cells = <1>;
        ranges = <0 0xc8000000 0x14000>;

        pubmon_sc_shmem: pubmon-sram@11c00 {
            compatible = "amlogic,gxl-pubmon-sc-shmem";
            reg = <0x11c00 0x400>;
        };
    };

    ddr-pub@c8836000 {
        compatible = "amlogic,gxl-ddr-pub-mon";
        reg = <0xc8836000 0x1000>;
        amlogic,sc-shmem = <&pubmon_sc_shmem>;
    };
```

## Documentation/devicetree/bindings/soc/amlogic/amlogic,gxl-pubmon-sc-shmem.yaml
```yaml
# SPDX-License-Identifier: (GPL-2.0-only OR BSD-2-Clause)
%YAML 1.2
---
$id: http://devicetree.org/schemas/soc/amlogic/amlogic,gxl-pubmon-sc-shmem.yaml#
$schema: http://devicetree.org/meta-schemas/core.yaml#

title: Amlogic GXL DDR PUB monitor SC shared-memory block

maintainers:
  - Da Xue <da@libre.computer>

description: |
  One KiB at the tail of the AO Cortex-M3 System Controller's heap
  (non-secure address 0xc8011c00, SRAM offset 0x11c00) that the System
  Controller publishes DDR PHY (PUB) VT tracking statistics into: a
  magic/version header, a seqcount-guarded field table, control words for
  the sample rate and a reset request/acknowledge pair, and a ring of the
  most recent delay-line changes.

properties:
  compatible:
    const: amlogic,gxl-pubmon-sc-shmem

  reg:
    maxItems: 1

required:
  - compatible
  - reg

additionalProperties: false

examples:
  - |
    sram@c8000000 {
        compatible = "mmio-sram";
        reg = <0xc8000000 0x14000>;
        #address-cells = <1>;
        #size-cells = <1>;
        ranges = <0 0xc8000000 0x14000>;

        pubmon_sc_shmem: pubmon-sram@11c00 {
            compatible = "amlogic,gxl-pubmon-sc-shmem";
            reg = <0x11c00 0x400>;
        };
    };
```

## Documentation/devicetree/bindings/soc/amlogic/amlogic,sm1-sc-heartbeat.yaml
```yaml
# SPDX-License-Identifier: (GPL-2.0-only OR BSD-2-Clause)
%YAML 1.2
---
$id: http://devicetree.org/schemas/soc/amlogic/amlogic,sm1-sc-heartbeat.yaml#
$schema: http://devicetree.org/meta-schemas/core.yaml#

title: Amlogic SM1 kernel heartbeat word for the open System Controller

maintainers:
  - Da Xue <da@libre.computer>

description: |
  One 32-bit word in the AP-to-SC half of the System Controller's shared
  SRAM (non-secure address 0xfffe7200) that the kernel advances every second.
  The open System Controller watches it: once it has seen the word change,
  a kernel that stops advancing it for the controller's grace period is
  reset through the AO watchdog.  The controller publishes its own view of
  the heartbeat in the 16 bytes that follow (0xfffe7210), so the region is
  0x20 bytes.  The word lies inside the window an mmio-sram node already
  claims, so the region is mapped without being requested.

properties:
  compatible:
    const: amlogic,sm1-sc-heartbeat

  reg:
    maxItems: 1

required:
  - compatible
  - reg

additionalProperties: false

examples:
  - |
    soc {
        #address-cells = <2>;
        #size-cells = <2>;

        sc-heartbeat@fffe7200 {
            compatible = "amlogic,sm1-sc-heartbeat";
            reg = <0x0 0xfffe7200 0x0 0x20>;
        };
    };
```
