## Documentation/devicetree/bindings/soc/mediatek/mediatek,mt8183-vp6.yaml
```yaml
# SPDX-License-Identifier: (GPL-2.0 OR BSD-2-Clause)
%YAML 1.2
---
$id: http://devicetree.org/schemas/soc/mediatek/mediatek,mt8183-vp6.yaml#
$schema: http://devicetree.org/meta-schemas/core.yaml#

title: MediaTek MT8183 VP6 (IPU / Vision-P6 DSP) core

maintainers:
  - Libre Computer <henryu38@gmail.com>

description: |
  The MT8183 (Helio-P60 / Genio 500) carries two Cadence Tensilica Vision-P6
  (VP6) DSP cores -- the "IPU" / "APU 1.0" vision/AI cluster -- exposed as
  ipu_core0 (@0x19180000) and ipu_core1 (@0x19280000) under the VPU_TOP power
  domain, fed by the ipu_conn (@0x19000000) and ipu_adl (@0x19010000) syscons.

  Each core has 192 KB instruction RAM + 256 KB data RAM (core-local L1) + an
  iDMA, and a host<->core mailbox (doorbell + info registers + IRQ). One node
  describes one core; the two cores load and run independently.

  This binds the mtk-vp6 driver, which stages a VP6 firmware image into a DDR
  buffer, points the core reset vector at it, releases the core from reset, and
  exposes a per-core /dev/vp6-N chardev (firmware-load + mailbox + shared-buffer
  ioctls). The userspace ABI is defined in include/uapi/linux/mtk-vp6.h.

  The core control / mailbox / clock-gate registers live in the core's own
  ipu_core0/1 syscon (@ 0x1918_0000 / 0x1928_0000, 0x1000); this node is a
  consumer that reaches them by phandle (mediatek,ipu-core) via regmap -- the
  same pattern as the ipu_probe node -- so it does not claim the register range
  itself. The firmware image is DDR-resident (loaded via the DMA/CMA path), so no
  IRAM/DRAM address window is described here.

properties:
  compatible:
    const: mediatek,mt8183-vp6

  interrupts:
    maxItems: 1
    description: core->host mailbox interrupt (optional until confirmed)

  clocks:
    maxItems: 3

  clock-names:
    items:
      - const: axi
      - const: ipu
      - const: jtag

  power-domains:
    maxItems: 1

  iommus:
    maxItems: 1
    description: optional M4U/larb stream if the VP6 iDMA is behind the IOMMU

  mediatek,core-index:
    $ref: /schemas/types.yaml#/definitions/uint32
    enum: [0, 1]
    description: which VP6 core this node describes (0 or 1)

  mediatek,ipu-core:
    $ref: /schemas/types.yaml#/definitions/phandle
    description: phandle to this core's ipu_core0/ipu_core1 syscon (cfg block)

  mediatek,ipu-conn:
    $ref: /schemas/types.yaml#/definitions/phandle
    description: phandle to the shared ipu_conn fabric syscon

required:
  - compatible
  - clocks
  - clock-names
  - power-domains
  - mediatek,core-index
  - mediatek,ipu-core
  - mediatek,ipu-conn

additionalProperties: false

examples:
  - |
    #include <dt-bindings/clock/mt8183-clk.h>
    #include <dt-bindings/power/mt8183-power.h>

    vp6_core0 {
        compatible = "mediatek,mt8183-vp6";
        clocks = <&ipu_core0 CLK_IPU_CORE0_AXI>,
                 <&ipu_core0 CLK_IPU_CORE0_IPU>,
                 <&ipu_core0 CLK_IPU_CORE0_JTAG>;
        clock-names = "axi", "ipu", "jtag";
        power-domains = <&spm MT8183_POWER_DOMAIN_VPU_CORE0>;
        mediatek,core-index = <0>;
        mediatek,ipu-core = <&ipu_core0>;
        mediatek,ipu-conn = <&ipu_conn>;
    };

...
```

## drivers/firmware/arm_scmi/vendors/libre/Kconfig
```kconfig
# SPDX-License-Identifier: GPL-2.0-only
menu "ARM SCMI Libre Computer Vendor Protocols"

config LIBRE_SCMI_TYPEC
	tristate "Libre Computer SCMI Type-C (UCSI) protocol"
	depends on ARM_SCMI_PROTOCOL || (COMPILE_TEST && OF)
	help
	  This enables the Libre Computer SCMI vendor protocol 0x80
	  ("lc-typec"), which carries a UCSI register file between Linux
	  and an SCMI server that owns a USB Type-C power port, such as
	  the RK3399 Cortex-M0 firmware on ROC-RK3399-PC. The UCSI client
	  is UCSI_SCMI.

	  To compile this driver as a module, choose M here: the
	  module will be called lc-typec.

config LIBRE_SCMI_WAKE_CFG
	tristate "Libre Computer SCMI wake-configuration protocol"
	depends on ARM_SCMI_PROTOCOL || (COMPILE_TEST && OF)
	default ARM_SCMI_PROTOCOL if ARCH_MESON
	help
	  This enables the Libre Computer SCMI vendor protocol 0x81
	  ("lc-wake-cfg") served by the Amlogic GXL open SC: the IR remote
	  wake list the SC matches while the board sleeps. meson-ir sets it
	  from rc-core's wakeup filter (/sys/class/rc/rcN/wakeup_filter).

	  To compile this driver as a module, choose M here: the
	  module will be called lc-wake-cfg.

endmenu
```

## drivers/firmware/meson/Kconfig
```kconfig
# SPDX-License-Identifier: GPL-2.0-only
#
# Amlogic Secure Monitor driver
#
config MESON_SM
	tristate "Amlogic Secure Monitor driver"
	depends on ARCH_MESON || COMPILE_TEST
	default ARCH_MESON
	depends on ARM64_4K_PAGES
	help
	  Say y here to enable the Amlogic secure monitor driver

config MESON_SM_DEVID
	tristate "Amlogic EL3 device credential service"
	depends on MESON_SM && ARM64
	help
	  /dev/devid-enroll (Identify, Burn) and /dev/devid (Answer) for the
	  device credential service in our TF-A (AML_DEVID).  The nodes appear
	  only when the firmware answers the service's VERSION call.

config MESON_GX_PM
	bool
	default ARCH_MESON if ARM64
	help
	  Say y here to enable the Amlogic GX SoC Power Management
```

## drivers/media/platform/amlogic/Kconfig
```kconfig
# SPDX-License-Identifier: GPL-2.0-only

comment "Amlogic media platform drivers"

source "drivers/media/platform/amlogic/c3/Kconfig"
source "drivers/media/platform/amlogic/meson-csi2/Kconfig"
source "drivers/media/platform/amlogic/meson-ge2d/Kconfig"
source "drivers/media/platform/amlogic/wave420l/Kconfig"
```

## drivers/media/platform/amlogic/meson-csi2/Kconfig
```kconfig
# SPDX-License-Identifier: GPL-2.0-only
config VIDEO_MESON_CSI2
	tristate "Amlogic Meson MIPI CSI-2 Receiver"
	depends on VIDEO_DEV
	depends on ARCH_MESON || COMPILE_TEST
	depends on OF
	select MEDIA_CONTROLLER
	select VIDEO_V4L2_SUBDEV_API
	select V4L2_FWNODE
	help
	  Support for the Amlogic Meson MIPI CSI-2 receiver found in
	  G12A, G12B, SM1, and A311D SoCs.

config VIDEO_MESON_CSI2_CAPTURE
	tristate "Amlogic Meson CSI-2 Capture Bridge"
	depends on VIDEO_MESON_CSI2
	select VIDEOBUF2_DMA_CONTIG
	help
	  V4L2 video capture bridge for the Amlogic Meson CSI-2 pipeline.
	  Creates /dev/videoX and provides the v4l2_device needed by
	  the CSI-2 receiver async notifier chain.
```

## drivers/media/platform/amlogic/wave420l/Kconfig
```kconfig
config VIDEO_MESON_WAVE420L
	tristate "Amlogic Meson Wave420L HEVC Encoder"
	depends on VIDEO_DEV
	depends on ARCH_MESON || COMPILE_TEST
	depends on VIDEO_MESON_VDEC
	select VIDEOBUF2_DMA_CONTIG
	select V4L2_MEM2MEM_DEV
	help
	  Support for the Chips&Media Wave420L HEVC encoder IP found in
	  Amlogic SM1 (S905D3) and G12B (A311D) SoCs.

	  To compile this driver as a module, choose M here: the module
	  will be called wave420l.
```

## drivers/media/platform/mediatek/aie/Kconfig
```kconfig
config VIDEO_MTK_AIE
	tristate "MediaTek AI Engine (AIE) driver"
	depends on VIDEO_DEV
	depends on OF
	select V4L2_MEM2MEM_DEV
	select VIDEOBUF2_DMA_CONTIG
	select MEDIA_CONTROLLER
	help
	  Enable support for the MediaTek AI Engine (AIE) hardware
	  accelerator for face detection and analysis.

	  The AIE driver is a V4L2 memory-to-memory device driver that
	  provides hardware-accelerated face detection, facial landmark
	  detection, and attribute analysis (age, gender, ethnicity)
	  functions. It can detect multiple faces of various sizes in
	  raw image data.

	  To compile this driver as a module, choose M here: the module
	  will be called mtk-aie.
```

## drivers/media/platform/mediatek/isp/dpe7/Kconfig
```kconfig
# SPDX-License-Identifier: GPL-2.0-only
config VIDEO_MEDIATEK_DPE7
	tristate "MediaTek MT8188 DPE stereo disparity (DVS) driver"
	depends on ARCH_MEDIATEK || COMPILE_TEST
	depends on VIDEO_DEV
	depends on OF
	select V4L2_MEM2MEM_DEV
	select VIDEOBUF2_DMA_CONTIG
	help
	  V4L2 memory-to-memory driver for the DVS engine of the MT8188
	  depth engine (DPE): it matches a rectified left/right image pair
	  and returns a disparity map in 1/8 pixel.

	  To compile this driver as a module, choose M here: the module
	  will be called mtk_dpe7.
```

## drivers/media/platform/mtk-vcodec-mt8167/Kconfig
```kconfig
# SPDX-License-Identifier: GPL-2.0-only
config VIDEO_MEDIATEK_VCODEC_MT8167
	tristate "Mediatek Video Codec driver for MT8365/MT8167 SoC (vendor, Genio 350)"
	depends on MTK_IOMMU || COMPILE_TEST
	depends on VIDEO_DEV
	depends on ARCH_MEDIATEK || COMPILE_TEST
	depends on VIDEO_MEDIATEK_VCU_MT8365
	select VIDEOBUF2_DMA_CONTIG
	select V4L2_MEM2MEM_DEV
	default n
	help
	    Vendor MT8365/MT8167 (Genio 350) video codec driver ported from
	    the mtk-v5.10 BSP. Provides HW encode/decode of a range of video
	    formats via the proprietary userspace (vpud) path; relies on the
	    VCU (CONFIG_VIDEO_MEDIATEK_VCU_MT8365) to talk to the codec engine.

	    This depends on the vendor VCU rather than mainline's
	    CONFIG_VIDEO_MEDIATEK_VPU. The original BSP "depends on
	    !VIDEO_MEDIATEK_VCODEC" guard is dropped: the vendor modules use a
	    distinct module name (mtk-vcodec-mt8167-dec/-enc/-common) and do
	    not bind the same DT compatibles as mainline's mtk-vcodec.

	    To compile this driver as modules, choose M here: the modules will
	    be called mtk-vcodec-mt8167-dec, mtk-vcodec-mt8167-enc and
	    mtk-vcodec-mt8167-common.
```

## drivers/media/platform/mtk-vcodec-mt8395/Kconfig
```kconfig
# SPDX-License-Identifier: GPL-2.0-only
config VIDEO_MEDIATEK_VCODEC_MT8395
	tristate "Mediatek Video Codec driver for MT8188/MT8370/MT8195 SoC (vendor, mt8395 / Genio 510)"
	depends on MTK_IOMMU || COMPILE_TEST
	depends on VIDEO_DEV
	depends on ARCH_MEDIATEK || COMPILE_TEST
	depends on VIDEO_MEDIATEK_VCU_MT8395
	select VIDEOBUF2_DMA_CONTIG
	select V4L2_MEM2MEM_DEV
	default n
	help
	    Vendor MT8188/MT8370/MT8195 (mt8395 generation, Genio 510) video
	    codec driver imported from the mtk-v6.6-mt8395 BSP. Provides HW
	    encode/decode of a range of video formats via the proprietary
	    userspace (vpud) path; relies on the VCU
	    (CONFIG_VIDEO_MEDIATEK_VCU_MT8395) to talk to the codec engine.

	    This depends on the vendor VCU rather than mainline's
	    CONFIG_VIDEO_MEDIATEK_VPU. It coexists with mainline's mtk-vcodec
	    (which serves the MediaTek Chromebooks): the colliding vendor
	    globals are prefixed via a force-included mtk_vcodec_rename.h and
	    the module names (mtk-vcodec-mt8395-dec/enc/common) are distinct,
	    so the two stacks build =y together with 0 symbol collisions.

	    Only the VCU codec transport is built; the Tinysys VCP transport
	    (CONFIG_MTK_TINYSYS_VCP_SUPPORT) is intentionally left unset.

	    To compile this driver as modules, choose M here: the modules will
	    be called mtk-vcodec-mt8395-dec, mtk-vcodec-mt8395-enc and
	    mtk-vcodec-mt8395-common.
```

## drivers/media/platform/mtk-vpu-mt8395/Kconfig
```kconfig
# SPDX-License-Identifier: GPL-2.0-only
config VIDEO_MEDIATEK_VCU_MT8395
	tristate "Mediatek VCU for MT8188/MT8370/MT8195 vendor vcodec (mt8395, Genio 510)"
	depends on VIDEO_DEV
	depends on ARCH_MEDIATEK || COMPILE_TEST
	help
	    Vendor MT8188/MT8370/MT8195 (mt8395 generation) VCU / /dev/vcu
	    provider. Imported from the mtk-vcu-driver repo (branch
	    mtk-v6.6-mt8395). Provides the char device the proprietary
	    userspace video codec daemon (vpud) opens, and the VCU
	    communication channel used by the mtk-vcodec-mt8395 V4L2 driver.

	    This builds the mtk-vcu-mt8395 module.

	    Named CONFIG_VIDEO_MEDIATEK_VCU_MT8395 (distinct from the mt8365
	    vendor VCU CONFIG_VIDEO_MEDIATEK_VCU_MT8365 and from mainline's
	    CONFIG_VIDEO_MEDIATEK_VPU) so all three coexist.

	    To compile this driver as a module, choose M here: the module
	    will be called mtk-vcu-mt8395.
```

## drivers/media/platform/mtk-vpu/Kconfig
```kconfig
# SPDX-License-Identifier: GPL-2.0-only
config VIDEO_MEDIATEK_VCU_MT8365
	tristate "Mediatek VCU/VPU for MT8365 vendor vcodec (Genio 350)"
	depends on VIDEO_DEV
	depends on ARCH_MEDIATEK || COMPILE_TEST
	help
	    Vendor MT8365 (Genio 350) Video Processor Unit / VCU driver.
	    Ported from the mtk-v5.10 BSP. Provides VPU firmware download
	    and the VCU communication channel used by the proprietary
	    userspace (vpud) HW video codec path on MT8365.

	    This builds the mtk-vpu-mt8365 and mtk-vcu-mt8365 modules. The
	    SoC suffix keeps them distinct from mainline's mtk-vpu
	    (drivers/media/platform/mediatek/vpu), which otherwise collides
	    at modules_check when CONFIG_MEDIA_SUPPORT=m.

	    Renamed from the BSP's CONFIG_VIDEO_MEDIATEK_VPU to avoid a
	    symbol collision with mainline's CONFIG_VIDEO_MEDIATEK_VPU
	    (drivers/media/platform/mediatek/vpu).

	    To compile this driver as modules, choose M here.
```

## drivers/media/test-drivers/v4l2loopback/Kconfig
```kconfig
# SPDX-License-Identifier: GPL-2.0
config VIDEO_V4L2_LOOPBACK
	tristate "V4L2 loopback device"
	depends on VIDEO_DEV
	help
	  Video devices whose output a userspace program writes and other
	  programs open as an ordinary camera (v4l2loopback 0.15.0, ported to
	  6.18). agentc's remote mode presents the browser's camera on one,
	  for apps that open /dev/video* themselves.

	  To compile this driver as a module, choose M here: the
	  module will be called v4l2loopback.
```

## drivers/misc/tenstorrent/Kconfig
```kconfig
# SPDX-License-Identifier: GPL-2.0-only
config TENSTORRENT
	tristate "Tenstorrent AI accelerator (Grayskull/Wormhole/Blackhole)"
	depends on PCI
	help
	  Kernel driver for Tenstorrent PCIe AI accelerators (Grayskull,
	  Wormhole, Blackhole). Provides /dev/tenstorrent/N char devices,
	  DMA-buf, TLB/BAR mapping, ARC mailbox messaging, and the default
	  idle power policy (gates Tensix/GDDR/L2CPU on last close).
	  Built in-tree so it always matches the running kernel.
	  To compile as a module choose M; the module is called tenstorrent.
```
