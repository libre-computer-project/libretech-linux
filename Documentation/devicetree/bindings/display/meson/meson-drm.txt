## Documentation/devicetree/bindings/display/meson/meson-drm.txt
```
Amlogic Meson Display Controller
================================

The Amlogic Meson Display controller is composed of several components
that are going to be documented below:

DMC|---------------VPU (Video Processing Unit)----------------|------HHI------|
   | vd1   _______     _____________    _________________     |               |
D  |-------|      |----|            |   |                |    |   HDMI PLL    |
D  | vd2   | VIU  |    | Video Post |   | Video Encoders |<---|-----VCLK      |
R  |-------|      |----| Processing |   |                |    |               |
   | osd2  |      |    |            |---| Enci ----------|----|-----VDAC------|
R  |-------| CSC  |----| Scalers    |   | Encp ----------|----|----HDMI-TX----|
A  | osd1  |      |    | Blenders   |   | Encl ----------|----|---------------|
M  |-------|______|----|____________|   |________________|    |               |
___|__________________________________________________________|_______________|


VIU: Video Input Unit
---------------------

The Video Input Unit is in charge of the pixel scanout from the DDR memory.
It fetches the frames addresses, stride and parameters from the "Canvas" memory.
This part is also in charge of the CSC (Colorspace Conversion).
It can handle 2 OSD Planes and 2 Video Planes.

VPP: Video Post Processing
--------------------------

The Video Post Processing is in charge of the scaling and blending of the
various planes into a single pixel stream.
There is a special "pre-blending" used by the video planes with a dedicated
scaler and a "post-blending" to merge with the OSD Planes.
The OSD planes also have a dedicated scaler for one of the OSD.

VENC: Video Encoders
--------------------

The VENC is composed of the multiple pixel encoders :
 - ENCI : Interlace Video encoder for CVBS and Interlace HDMI
 - ENCP : Progressive Video Encoder for HDMI
 - ENCL : LCD LVDS Encoder
The VENC Unit gets a Pixel Clocks (VCLK) from a dedicated HDMI PLL and clock
tree and provides the scanout clock to the VPP and VIU.
The ENCI is connected to a single VDAC for Composite Output.
The ENCI and ENCP are connected to an on-chip HDMI Transceiver.

Device Tree Bindings:
---------------------

VPU: Video Processing Unit
--------------------------

Required properties:
- compatible: value should be different for each SoC family as :
	- GXBB (S905) : "amlogic,meson-gxbb-vpu"
	- GXL (S905X, S905D) : "amlogic,meson-gxl-vpu"
	- GXM (S912) : "amlogic,meson-gxm-vpu"
	followed by the common "amlogic,meson-gx-vpu"
- reg: base address and size of he following memory-mapped regions :
	- vpu
	- hhi
	- dmc
- reg-names: should contain the names of the previous memory regions
- interrupts: should contain the VENC Vsync interrupt number

- ports: A ports node with endpoint definitions as defined in
  Documentation/devicetree/bindings/media/video-interfaces.txt. The
  second port should be the output endpoints for VENC connectors.

CBVS Output
-----------

The VENC can output Composite/CVBS output via a dedicated VDAC, usage of such
Composite output is optional.

Required properties:
- compatible: value should be different for each SoC family as :
 	- GXBB (S905) : "amlogic,meson-gxbb-cvbs"
 	- GXL (S905X, S905D) : "amlogic,meson-gxl-cvbs"
 	- GXM (S912) : "amlogic,meson-gxm-cvbs"
	followed by the common "amlogic,meson-gx-cvbs"

- ports: A ports node with endpoint definitions as defined in
  Documentation/devicetree/bindings/media/video-interfaces.txt. The
  first port should be the input endpoints, connected ot the VPU node.

Example:

venc_cvbs: venc-cvbs {
	compatible = "amlogic,meson-gxbb-cvbs";
	status = "okay";

	ports {
		#address-cells = <1>;
		#size-cells = <0>;

		enc_cvbs_in: port@0 {
			 #address-cells = <1>;
			 #size-cells = <0>;
			 reg = <0>;

			 venc_cvbs_in_vpu: endpoint@0 {
				 reg = <0>;
				 remote-endpoint = <&vpu_out_venc_cvbs>;
			};
		};
	};
};

vpu: vpu@d0100000 {
	compatible = "amlogic,meson-gxbb-vpu";
	reg = <0x0 0xd0100000 0x0 0x100000>,
	      <0x0 0xc883c000 0x0 0x1000>,
	      <0x0 0xc8838000 0x0 0x1000>;
	reg-names = "base", "hhi", "dmc";
	interrupts = <GIC_SPI 3 IRQ_TYPE_EDGE_RISING>;

	ports {
		#address-cells = <1>;
		#size-cells = <0>;

		vpu_out: port@1 {
			 #address-cells = <1>;
			 #size-cells = <0>;
			 reg = <1>;

			 vpu_out_venc_cvbs: endpoint@0 {
				 reg = <0>;
				 remote-endpoint = <&venc_cvbs_in_vpu>;
			 };
		 };
	};
};
```

## Documentation/devicetree/bindings/net/amlogic,gxl-mdio-mux.yaml
```yaml
# SPDX-License-Identifier: GPL-2.0-only OR BSD-2-Clause
%YAML 1.2
---
$id: http://devicetree.org/schemas/net/amlogic,gxl-mdio-mux.yaml#
$schema: http://devicetree.org/meta-schemas/core.yaml#

title: Amlogic GXL MDIO bus multiplexer

maintainers:
  - Jerome Brunet <jbrunet@baylibre.com>

description:
  This is a special case of a MDIO bus multiplexer. It allows to choose between
  the internal mdio bus leading to the embedded 10/100 PHY or the external
  MDIO bus on the Amlogic GXL SoC family.

allOf:
  - $ref: mdio-mux.yaml#

properties:
  compatible:
    const: amlogic,gxl-mdio-mux

  reg:
    maxItems: 1

  clocks:
    maxItems: 1

  clock-names:
    items:
      - const: ref

required:
  - compatible
  - reg
  - clocks
  - clock-names

unevaluatedProperties: false

examples:
  - |
    eth_phy_mux: mdio@558 {
      #address-cells = <1>;
      #size-cells = <0>;
      compatible = "amlogic,gxl-mdio-mux";
      clocks = <&refclk>;
      clock-names = "ref";
      reg = <0x558 0xc>;
      mdio-parent-bus = <&mdio0>;

      external_mdio: mdio@0 {
        #address-cells = <1>;
        #size-cells = <0>;
        reg = <0x0>;
      };

      internal_mdio: mdio@1 {
        #address-cells = <1>;
        #size-cells = <0>;
        reg = <0x1>;
      };
    };
```

## Documentation/devicetree/bindings/phy/qcom,usb-hsic-phy.txt
```
Qualcomm's MDM9615 USB HISC transceiver controller

- compatible:
    Usage: required
    Value type: <string>
    Definition: Should contain "qcom,usb-hsic-phy".

- reg:
    Usage: required
    Value type: <prop-encoded-array>
    Definition: USB PHY base address and length of the register map

- clocks:
    Usage: required
    Value type: <prop-encoded-array>
    Definition: See clock-bindings.txt section "consumers". List of
                5 clock specifiers for interface and core controller
                clocks.

- clock-names:
    Usage: required
    Value type: <string>
    Definition: Must contain "core", "alt-core", "phy", "cal" and "iface" strings.

- vddcx-supply:
    Usage: required
    Value type: <phandle>
    Definition: phandle to the regulator VDCCX supply node.

- resets:
    Usage: required
    Value type: <prop-encoded-array>
    Definition: See reset.txt section "consumers". PHY reset specifier.

- reset-names:
    Usage: required
    Value type: <string>
    Definition: Must contain "link" string.

- interrupts:
    Usage: required
    Value type: <prop-encoded-array>
    Definition: Interrupt line definition for the PHY

- dr_mode:
    Usage: required
    Value type: <prop-encoded-array>
    Definition: Setup the PHY mode, either "host", "gadget" or "dual"

- qcom,vdd-levels:
    Usage: required for MDM9615
    Value type: <prop-encoded-array>
    Definition: Setup the valid vdd levers for the vddx-supply

- phy_type:
    Usage: required
    Value type: <prop-encoded-array>
    Definition: Shall be "hisc"

- qcom,tlmm:
    Usage: required for MDM961
    Value type: <prop-encoded-array>
    Definition: TLMM syscon phandle to setup the HSIC lines

- qcom,tlmm-cfg:
    Usage: required for MDM961
    Value type: <prop-encoded-array>
    Definition: Shall be two entries of offset, data of the HSIC lines setup

Example:
	usb_phy: phy@12540000 {
		compatible = "qcom,usb-hsic-phy";
		reg = <0x78d9000 0x400>;
		interrupts      = <GIC_SPI 232 IRQ_TYPE_NONE>;
		dr_mode         = "host";

		vddcx-supply = <&pm8018_vdd_dig_corner>;

		clocks = <&gcc USB_HSIC_SYSTEM_CLK>,
		         <&gcc USB_HSIC_XCVR_FS_CLK>,
			 <&gcc USB_HSIC_HSIC_CLK>,
			 <&gcc USB_HSIC_HSIO_CAL_CLK>,
			 <&gcc USB_HSIC_H_CLK>;
		clock-names = "core", "alt-core", "phy", "cal", "iface";

		resets = <&gcc USB_HSIC_RESET>;
		reset-names = "link";
		qcom,vdd-levels = <1 2 4>;
		phy_type        = "hsic";

		qcom,tlmm       = <&msmgpio>;
		qcom,tlmm-cfg   = <0x20CC 0x034A4E10
				   0x20C8 0x034A4E10>;
	};
```
