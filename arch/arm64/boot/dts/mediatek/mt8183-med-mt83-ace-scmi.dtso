// SPDX-License-Identifier: (GPL-2.0 OR MIT)
/*
 * MED-MT83-ACE SCMI v1 FIT overlay. Applied only by ace-dram-shell-fit.sh
 * when ACE_SCMI=1. Adds the SMT page as reserved-memory no-map and enables
 * the board's disabled firmware/scmi node. Zero protocol children.
 * The page is the Libre Computer TF-A fork's MTK_SCMI_SHMEM_BASE
 * (TZRAM_BASE + TZRAM_SIZE, TZRAM at 0x40000000): only that firmware
 * carries the SCMI server, so the overlay follows its map.
 */

/dts-v1/;
/plugin/;

&{/reserved-memory} {
	scmi_shmem: shmem@40030000 {
		compatible = "arm,scmi-shmem";
		reg = <0 0x40030000 0 0x1000>;
		no-map;
	};
};

&scmi {
	shmem = <&scmi_shmem>;
	status = "okay";
};
