// SPDX-License-Identifier: (GPL-2.0+ OR MIT)
/*
 * Copyright (c) 2026 Libre Computer
 *
 * AML-S905X-CC-V3 on the libre firmware chain (our TF-A, low-16 MiB block
 * with the optional OP-TEE band at its top), the only chain this board
 * boots: the control and booted DTB of its u-boot target.
 */

/dts-v1/;

#include "meson-gxl-s905x-libretech-cc-v3.dtsi"
#include "meson-gx-libre-firmware.dtsi"
