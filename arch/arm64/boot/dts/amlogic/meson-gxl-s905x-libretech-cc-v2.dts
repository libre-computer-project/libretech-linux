// SPDX-License-Identifier: (GPL-2.0+ OR MIT)
/*
 * Copyright (c) 2020 BayLibre, SAS.
 * Author: Jerome Brunet <jbrunet@baylibre.com>
 *
 * AML-S905X-CC-V2 on the VENDOR firmware chain. The libre chain boots
 * meson-gxl-s905x-libretech-cc-v2-libre.dts instead.
 */

/dts-v1/;

#include "meson-gxl-s905x-libretech-cc-v2.dtsi"
#include "meson-gx-vendor-firmware.dtsi"
#include "meson-libretech-ramoops.dtsi"
