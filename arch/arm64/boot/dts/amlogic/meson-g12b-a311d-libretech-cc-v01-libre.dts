// SPDX-License-Identifier: (GPL-2.0+ OR MIT)
/*
 * Copyright (c) 2026 Libre Computer
 *
 * AML-A311D-CC-V01 on the LIBRE firmware chain (our TF-A, low-16 MiB secure
 * layout): the control and booted DTB of the aml-a311d-cc-v01 u-boot target.
 * V0.1 is not supported on the vendor chain.
 */

/dts-v1/;

#include "meson-g12b-a311d-libretech-cc-v01.dtsi"
#include "meson-g12-libre-firmware.dtsi"
