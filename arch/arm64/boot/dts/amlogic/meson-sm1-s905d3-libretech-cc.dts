// SPDX-License-Identifier: (GPL-2.0+ OR MIT)
/*
 * Copyright (c) 2023 BayLibre, SAS.
 * Author: Jerome Brunet <jbrunet@baylibre.com>
 *
 * AML-S905D3-CC on the VENDOR firmware chain. The libre chain boots
 * meson-sm1-s905d3-libretech-cc-libre.dts instead.
 */

/dts-v1/;

#include "meson-sm1-s905d3-libretech-cc.dtsi"
#include "meson-g12-vendor-firmware.dtsi"
#include "meson-libretech-ramoops.dtsi"

/*
 * The vendor chain's CPU description: clk-based OPPs driven by cpufreq-dt.
 * It lives in this leaf, not in the shared -cc.dtsi, so the -libre leaf
 * carries no OPP table (its SC owns sys_pll).
 */
&cpu0 {
	cpu-supply = <&vddcpu_b>;
	operating-points-v2 = <&cpu_opp_table>;
	clocks = <&clkc CLKID_CPU_CLK>;
};

&cpu1 {
	cpu-supply = <&vddcpu_b>;
	operating-points-v2 = <&cpu_opp_table>;
	clocks = <&clkc CLKID_CPU1_CLK>;
};

&cpu2 {
	cpu-supply = <&vddcpu_b>;
	operating-points-v2 = <&cpu_opp_table>;
	clocks = <&clkc CLKID_CPU2_CLK>;
};

&cpu3 {
	cpu-supply = <&vddcpu_b>;
	operating-points-v2 = <&cpu_opp_table>;
	clocks = <&clkc CLKID_CPU3_CLK>;
};
