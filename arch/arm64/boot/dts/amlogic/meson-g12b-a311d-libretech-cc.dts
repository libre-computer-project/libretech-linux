// SPDX-License-Identifier: (GPL-2.0+ OR MIT)
/*
 * Copyright (c) 2023 BayLibre, SAS.
 * Author: Jerome Brunet <jbrunet@baylibre.com>
 *
 * AML-A311D-CC on the VENDOR firmware chain. The libre chain boots
 * meson-g12b-a311d-libretech-cc-libre.dts instead.
 */

/dts-v1/;

#include "meson-g12b-a311d-libretech-cc.dtsi"
#include "meson-g12-vendor-firmware.dtsi"
#include "meson-libretech-ramoops.dtsi"
