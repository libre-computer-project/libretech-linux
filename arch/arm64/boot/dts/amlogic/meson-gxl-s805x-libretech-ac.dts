// SPDX-License-Identifier: (GPL-2.0+ OR MIT)
/*
 * Copyright (c) 2018 BayLibre, SAS.
 * Author: Neil Armstrong <narmstrong@baylibre.com>
 * Author: Jerome Brunet <jbrunet@baylibre.com>
 *
 * AML-S805X-AC on the VENDOR firmware chain. The libre chain boots
 * meson-gxl-s805x-libretech-ac-libre.dts instead.
 */

/dts-v1/;

#include "meson-gxl-s805x-libretech-ac.dtsi"
#include "meson-gx-vendor-firmware.dtsi"
