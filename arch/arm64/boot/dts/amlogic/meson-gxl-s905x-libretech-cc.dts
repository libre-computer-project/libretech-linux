// SPDX-License-Identifier: (GPL-2.0+ OR MIT)
/*
 * Copyright (c) 2017 BayLibre, SAS.
 * Author: Neil Armstrong <narmstrong@baylibre.com>
 * Author: Jerome Brunet <jbrunet@baylibre.com>
 *
 * AML-S905X-CC on the VENDOR firmware chain. The libre chain boots
 * meson-gxl-s905x-libretech-cc-libre.dts instead.
 */

/dts-v1/;

#include "meson-gxl-s905x-libretech-cc.dtsi"
#include "meson-gx-vendor-firmware.dtsi"
#include "meson-libretech-ramoops.dtsi"
